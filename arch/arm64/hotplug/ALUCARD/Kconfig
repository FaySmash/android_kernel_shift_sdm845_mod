## arch/arm64/hotplug/ALUCARD/Kconfig
```kconfig
config ALUCARD_HOTPLUG
	bool "CPU Hotplug - Alucard"
	default n
	help
	  Generic Alucard-hotplug cpu hotplug driver for ARM SOCs
```

## arch/arm64/hotplug/AUTOSMP/Kconfig
```kconfig
config ASMP
    bool "CPU Hotplug -  AutoSMP"
    depends on SMP
    default n
    help
      Automatically hotplugs the multiple cpu cores on and off
      based on cpu load and suspend state
```

## arch/arm64/hotplug/BRICKED/Kconfig
```kconfig
config BRICKED_HOTPLUG
	bool "CPU Hotplug - Bricked"
	depends on MSM_RUN_QUEUE_STATS
	default n
	help
	 This enables kernel based multi core control based on mpdecison.
```

## arch/arm64/hotplug/INTELLIPLUG/Kconfig
```kconfig
config INTELLI_PLUG
	   bool "CPU Hotplug - IntelliPlug"
	   depends on MSM_RUN_QUEUE_STATS
	   default n
	   help
		 This enables kernel based multi core control.
```

## arch/arm64/hotplug/MAKO/Kconfig
```kconfig
config MAKO_HOTPLUG
    bool "CPU Hotplug - Mako"
    default n
    help
      Mako Hotplug: A custom hotplug by fransico franco
```

## arch/arm64/hotplug/THUNDERPLUG/Kconfig
```kconfig
config THUNDERPLUG_CONTROL
	bool "CPU Hotplug - ThunderPlug"
	default n
	help
	  This driver uses powersuspend to take down the cpu cores
	  on a octa core device.
```
